## holder/main/Kconfig.projbuild
```kconfig
menu "User Connection Configuration"
    config SSID
        string SSID
        default "PadillaHouseFam"
    config PASSWORD
        string PASSWORD
        default sparecard240
endmenu
```
